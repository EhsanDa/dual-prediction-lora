/* node_host.c -- run the node application against the golden vectors.
 *
 * hil_host.c proves edge_codec.c is byte-identical on the part. It drives the
 * codec directly, so it says nothing about the APPLICATION around it: the
 * quantiser, the order of the hourly cycle, the day-boundary sequence, the
 * packet encoders, the transmit decision. Those are main.ino's, and until
 * 2026-09-28 they had never been executed at all.
 *
 * This program closes that. The node replays meter_trace.h -- the same inputs
 * golden_vectors.h records, byte for byte -- through the whole application,
 * and every hour's u_hat, e and flag byte must equal the reference's. It works
 * because SCALE_K is negative: kWh = u * 2^SCALE_K is an exact binary
 * fraction, so quantise() returns the integer it started from.
 *
 * IT COMPARES AGAINST node_expected.h, NOT golden_vectors.h, AND THAT IS NOT A
 * WEAKER CHECK. The golden fixture deliberately drops the resync on day 5 so
 * that test_host.c covers codec_new_day; a node applies its day boundary
 * unconditionally, because the resync carries the post-update weights and
 * needs no ACK. So a real node cannot reproduce the golden trace past hour 120
 * and should not be expected to -- the first run of this program diverged
 * there and the fixture, not the firmware, was what was wrong.
 * node_expected.h is the same reference codec over the same inputs with every
 * boundary applied. Both files are generated by export/gen_meter_trace.py.
 *
 * Exit: 0 identical, 1 mismatch, 2 setup failure.
 */
#define _POSIX_C_SOURCE 200809L

#include <stdio.h>
#include <stdlib.h>
#include <string.h>
#include <stdint.h>
#include <errno.h>
#include <fcntl.h>
#include <unistd.h>
#include <termios.h>
#include <poll.h>
#include <time.h>

#include "../edge_codec.h"
#include "node_expected.h"

static int g_fd = -1;
static int failures = 0;

static long now_ms(void)
{
    struct timespec ts;
    clock_gettime(CLOCK_MONOTONIC, &ts);
    return ts.tv_sec * 1000L + ts.tv_nsec / 1000000L;
}

static int read_line(char *buf, size_t max, int timeout_ms)
{
    size_t n = 0;
    long deadline = now_ms() + timeout_ms;
    for (;;) {
        struct pollfd pfd = { g_fd, POLLIN, 0 };
        long remain = deadline - now_ms();
        char c;
        if (remain <= 0) { buf[n] = '\0'; return -1; }
        if (poll(&pfd, 1, (int)remain) <= 0) { buf[n] = '\0'; return -1; }
        if (read(g_fd, &c, 1) != 1) continue;
        if (c == '\r') continue;
        if (c == '\n') { buf[n] = '\0'; return (int)n; }
        if (n + 1 < max) buf[n++] = c;
    }
}

static void fail(const char *what, uint32_t t, long got, long want)
{
    if (failures < 20)
        printf("  MISMATCH %-7s at t=%4u: got %ld, want %ld\n", what, t, got, want);
    failures++;
}

int main(int argc, char **argv)
{
    const char *dev = (argc > 1) ? argv[1] : "/dev/ttyACM0";
    struct termios tio;
    char line[512];
    uint32_t seen = 0;
    int done = 0, board = -1;
    unsigned frames = 0, bytes = 0, airms = 0, stackfree = 0;

    printf("the NODE APPLICATION on an ATmega328P vs edge/codec.py -- %d hours\n",
           NODE_EXP_N);
    printf("expecting %d exceptions over %d day boundaries, all applied\n",
           NODE_EXP_N_TX, NODE_EXP_N_BOUND);
    printf("port: %s\n", dev);

    if ((g_fd = open(dev, O_RDWR | O_NOCTTY)) < 0) {
        fprintf(stderr, "open %s: %s\n", dev, strerror(errno)); return 2;
    }
    if (tcgetattr(g_fd, &tio) != 0) { perror("tcgetattr"); return 2; }
    cfmakeraw(&tio);
    cfsetispeed(&tio, B115200);
    cfsetospeed(&tio, B115200);
    tio.c_cflag |= (CLOCAL | CREAD | HUPCL);
    tio.c_cflag &= ~CRTSCTS;
    tio.c_cc[VMIN] = 0; tio.c_cc[VTIME] = 0;
    if (tcsetattr(g_fd, TCSANOW, &tio) != 0) { perror("tcsetattr"); return 2; }

    /* Opening the port reset the board; the application starts on its own and
     * streams. Nothing is sent to it -- it is not a command protocol. */
    tcflush(g_fd, TCIOFLUSH);

    while (!done) {
        int n = read_line(line, sizeof line, 20000);
        unsigned t, flags;
        int uhat, e;

        if (n < 0) { fprintf(stderr, "\ntimeout after %u hours\n", seen); break; }
        if (n == 0) continue;

        if (line[0] == '#') {
            printf("%s\n", line);
            sscanf(line, "# READY node proto %*u board %d", &board);
            sscanf(line, "# FRAMES %u BYTES %u AIRMS %u", &frames, &bytes, &airms);
            sscanf(line, "# STACKFREE %u", &stackfree);
            if (strstr(line, "NODE DONE")) done = 1;
            continue;
        }

        if (sscanf(line, "H %u %d %d %u", &t, &uhat, &e, &flags) != 4) {
            fprintf(stderr, "unparsed: %s\n", line);
            continue;
        }
        if (t >= (unsigned)NODE_EXP_N) { fail("t", t, t, NODE_EXP_N - 1); continue; }

        if (uhat != NODE_EXP_UHAT[t])        fail("u_hat", t, uhat, NODE_EXP_UHAT[t]);
        if (e    != NODE_EXP_E[t])           fail("e", t, e, NODE_EXP_E[t]);
        if (flags != (unsigned)NODE_EXP_FLAGS[t])
            fail("flags", t, (long)flags, NODE_EXP_FLAGS[t]);
        seen++;
    }
    close(g_fd);

    printf("\nboard %d, %u hours reported\n", board, seen);
    if (stackfree)
        printf("peak stack: %u B of the free region still painted\n", stackfree);
    printf("frames sent %u, %u bytes encoded", frames, bytes);
    if (airms) printf(", %u ms on air", airms);
    printf("\n");

    if (seen != (unsigned)NODE_EXP_N) {
        printf("FATAL: %u of %d hours arrived\n", seen, NODE_EXP_N);
        return 2;
    }
    if (failures) {
        printf("\nFAILED: %d mismatches. The application around the codec does "
               "NOT reproduce\nthe reference.\n", failures);
        return 1;
    }
    if (frames != (unsigned)(NODE_EXP_N_TX + NODE_EXP_N_BOUND)) {
        printf("\nFAILED: %u frames sent, expected %d (%d exceptions + %d "
               "resyncs).\n", frames, NODE_EXP_N_TX + NODE_EXP_N_BOUND,
               NODE_EXP_N_TX, NODE_EXP_N_BOUND);
        return 1;
    }
    printf("\nOK: %d hours -- u_hat, e and flags byte-identical to the Python "
           "reference,\nthrough the WHOLE application on an ATmega328P: "
           "quantiser, hourly cycle,\nday-boundary order, transmit decision "
           "and packet encoders.\n", NODE_EXP_N);
    return 0;
}
